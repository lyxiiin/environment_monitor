## components/mqtt_app_client/Kconfig
```kconfig
menu "MQTT Client Configuration"
    config MQTT_BROKER_URI
        string "mqtt broker"
        default "mqtt://YOUR_BROKER_IP:1883"
        help
            MQTT broker address with protocol and port.

    config MQTT_CLIENT_ID
        string "mqtt client id"
        default "esp32_env_monitor_001"
        help
            Unique client identifier for the MQTT broker.

    config MQTT_USERNAME
        string "MQTT Username"
        default "YOUR_MQTT_USERNAME"
        help
            Username for broker authentication (leave empty if not required)

    config MQTT_PASSWORD
        string "MQTT Password"
        default "YOUR_MQTT_PASSWORD"
        help
            Password for broker authentication.

    config MQTT_PUBLISH_TOPIC
        string "Publish Topic"
        default "env_monitor/data"
        help
            Topic for publishing sensor data.

    config MQTT_SUBSCRIBE_TOPIC
        string "Subscribe Topic"
        default "env_monitor/command"
        help
            Topic for subscribing user command.

    config MQTT_KEEPALIVE
        int "Keep-Alive Interval (seconds)"
        default 60
        help
            MQTT keep-alive heartbeat interval.
    config MQTT_QOS
        int "MQTT Qos Level (0/1/2)"
        range 0 2
        default 1
        help
            Quality of Service: 0=At most once, 1=At least once, 2=Exactly once.
            
endmenu
```

## components/wifi_manager/Kconfig
```kconfig
menu "WiFi Manager Configuration"
    config WIFI_MANAGER_SSID
        string "WiFi SSID"
        default "YOUR_WIFI_SSID"
        help
            WiFi network name to connect to.
    config WIFI_MANAGER_PASSWORD
        string "WiFi Password"
        default "YOUR_WIFI_PASSWORD"
        help
            WiFi password (WAP/WAP2).
    config WIFI_MANAGER_MAX_RETRY
            int "Maximum Retry Count"
            default 5
            help
                Maximum reconnection attempts before giving up.
    choice WIFI_MANAGER_AUTH_MODE
        prompt "WiFi Authentication Mode Threshold"
        default WIFI_MANAGER_AUTH_WPA2_PSK
        config WIFI_MANAGER_AUTH_OPEN
            bool "OPEN"
        config WIFI_MANAGER_AUTH_WPA2_PSK
            bool "WPA2 PSK"
        config WIFI_MANAGER_AUTH_WPA3_PSK
            bool "WPA3 PSK"
    endchoice
endmenu
```

## sdkconfig.defaults
```kconfig
# Target
CONFIG_IDF_TARGET="esp32s3"

# FreeRTOS
CONFIG_FREERTOS_HZ=1000

# MQTT
CONFIG_MQTT_PROTOCOL_311=y
```
